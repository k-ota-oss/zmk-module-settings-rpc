## Kconfig
```kconfig
config ZMK_SETTINGS_RPC
    bool "Enable ZMK core settings RPC module"

if ZMK_SETTINGS_RPC

config ZMK_SETTINGS_RPC_STUDIO
    bool "Enable ZMK core settings custom Studio RPC"
    depends on ZMK_STUDIO

config ZMK_SPLIT_RELAY_EVENT
    bool "Enable event relay between central and peripheral for split keyboards"
    default y
    depends on ZMK_SPLIT
    help
      Enable relaying events between central and peripheral halves for split keyboards.
      This is required for propagating settings changes to peripheral keyboards.

config ZMK_SPLIT_RELAY_EVENT_TYPE_NAME_LEN
    int "Maximum length of relay event type name"
    default 32
    depends on ZMK_SPLIT_RELAY_EVENT

config ZMK_SPLIT_RELAY_EVENT_DATA_LEN
    int "Maximum length of relay event data"
    default 64
    depends on ZMK_SPLIT_RELAY_EVENT

# DYA Studio
CONFIG_ZMK_STUDIO=y
CONFIG_ZMK_STUDIO_LOCKING=n
CONFIG_ZMK_STUDIO_TRANSPORT_BLE=y
CONFIG_ZMK_STUDIO_LOCK_BLE_DIRECT_ADVERTISING_ON_UNLOCK=y
CONFIG_ZMK_RUNTIME_INPUT_PROCESSOR=y
CONFIG_ZMK_RUNTIME_INPUT_PROCESSOR_STUDIO_RPC=y
CONFIG_ZMK_BLE_MANAGEMENT=y
CONFIG_ZMK_BLE_MANAGEMENT_STUDIO_RPC=y
CONFIG_ZMK_BATTERY_HISTORY=y
CONFIG_ZMK_BATTERY_HISTORY_STUDIO_RPC=y
CONFIG_ZMK_SETTINGS_RPC=y
CONFIG_ZMK_SETTINGS_RPC_STUDIO=y

endif
```
